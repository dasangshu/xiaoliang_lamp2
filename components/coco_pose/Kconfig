## components/coco_pose/Kconfig
```kconfig
menu "models: coco_pose"
    config FLASH_COCO_POSE_YOLO11N_POSE_S8_V1
        bool "flash coco_pose_yolo11n_pose_s8_v1"
        depends on !COCO_POSE_MODEL_IN_SDCARD
        default n
    config FLASH_COCO_POSE_YOLO11N_POSE_S8_V2
        bool "flash coco_pose_yolo11n_pose_s8_v2"
        depends on !COCO_POSE_MODEL_IN_SDCARD
        default y
    config FLASH_COCO_POSE_YOLO11N_POSE_320_P4_V3
        bool "flash coco_pose_yolo11n_pose_320_p4_v3"
        depends on !COCO_POSE_MODEL_IN_SDCARD && IDF_TARGET_ESP32P4
        default n
    config FLASH_COCO_POSE_YOLO11N_POSE_256_P4
        bool "flash coco_pose_yolo11n_pose_256_p4"
        depends on !COCO_POSE_MODEL_IN_SDCARD && IDF_TARGET_ESP32P4
        default n
    config FLASH_COCO_POSE_YOLO11N_POSE_224_P4
        bool "flash coco_pose_yolo11n_pose_224_p4"
        depends on !COCO_POSE_MODEL_IN_SDCARD && IDF_TARGET_ESP32P4
        default n
    config FLASH_COCO_POSE_YOLO11N_POSE_224_P4_TRAINED
        bool "flash coco_pose_yolo11n_pose_224_p4_trained (Custom Trained)"
        depends on !COCO_POSE_MODEL_IN_SDCARD && IDF_TARGET_ESP32P4
        default n

    config FLASH_COCO_POSE_YOLO11N_POSE_224_P4_NEW
        bool "flash coco_pose_yolo11n_pose_224_p4_new (New Trained)"
        depends on !COCO_POSE_MODEL_IN_SDCARD && IDF_TARGET_ESP32P4
        default n

    config FLASH_COCO_POSE_YOLO11N_POSE_224_P4_CUSTOM
        bool "flash coco_pose_yolo11n_pose_224_p4_custom (Custom Trained)"
        depends on !COCO_POSE_MODEL_IN_SDCARD && IDF_TARGET_ESP32P4
        default n

    choice
        prompt "default model"
        default COCO_POSE_YOLO11N_POSE_S8_V2
        help
            default coco_pose model
        config COCO_POSE_YOLO11N_POSE_S8_V1
            bool "coco_pose_yolo11n_pose_s8_v1"
            depends on COCO_POSE_MODEL_IN_SDCARD || FLASH_COCO_POSE_YOLO11N_POSE_S8_V1
        config COCO_POSE_YOLO11N_POSE_S8_V2
            bool "coco_pose_yolo11n_pose_s8_v2"
            depends on COCO_POSE_MODEL_IN_SDCARD || FLASH_COCO_POSE_YOLO11N_POSE_S8_V2
        config COCO_POSE_YOLO11N_POSE_320_P4_V3
            bool "coco_pose_yolo11n_pose_320_p4_v3"
            depends on (COCO_POSE_MODEL_IN_SDCARD || FLASH_COCO_POSE_YOLO11N_POSE_320_P4_V3) && IDF_TARGET_ESP32P4
        config COCO_POSE_YOLO11N_POSE_256_P4
            bool "coco_pose_yolo11n_pose_256_p4"
            depends on (COCO_POSE_MODEL_IN_SDCARD || FLASH_COCO_POSE_YOLO11N_POSE_256_P4) && IDF_TARGET_ESP32P4
        config COCO_POSE_YOLO11N_POSE_224_P4
            bool "coco_pose_yolo11n_pose_224_p4"
            depends on (COCO_POSE_MODEL_IN_SDCARD || FLASH_COCO_POSE_YOLO11N_POSE_224_P4) && IDF_TARGET_ESP32P4
        config COCO_POSE_YOLO11N_POSE_224_P4_TRAINED
            bool "coco_pose_yolo11n_pose_224_p4_trained (Custom Trained)"
            depends on (COCO_POSE_MODEL_IN_SDCARD || FLASH_COCO_POSE_YOLO11N_POSE_224_P4_TRAINED) && IDF_TARGET_ESP32P4
        config COCO_POSE_YOLO11N_POSE_224_P4_NEW
            bool "coco_pose_yolo11n_pose_224_p4_new (New Trained)"
            depends on (COCO_POSE_MODEL_IN_SDCARD || FLASH_COCO_POSE_YOLO11N_POSE_224_P4_NEW) && IDF_TARGET_ESP32P4
        config COCO_POSE_YOLO11N_POSE_224_P4_CUSTOM
            bool "coco_pose_yolo11n_pose_224_p4_custom (Custom Trained)"
            depends on (COCO_POSE_MODEL_IN_SDCARD || FLASH_COCO_POSE_YOLO11N_POSE_224_P4_CUSTOM) && IDF_TARGET_ESP32P4
    endchoice

    config DEFAULT_COCO_POSE_MODEL
        int
        default 0 if COCO_POSE_YOLO11N_POSE_S8_V1
        default 1 if COCO_POSE_YOLO11N_POSE_S8_V2
        default 2 if COCO_POSE_YOLO11N_POSE_320_S8_V2
        default 3 if COCO_POSE_YOLO11N_POSE_320_P4_V3
        default 4 if COCO_POSE_YOLO11N_POSE_256_P4
        default 5 if COCO_POSE_YOLO11N_POSE_224_P4
        default 6 if COCO_POSE_YOLO11N_POSE_224_P4_TRAINED
        default 7 if COCO_POSE_YOLO11N_POSE_224_P4_NEW
        default 8 if COCO_POSE_YOLO11N_POSE_224_P4_CUSTOM

    choice
        prompt "model location"
        default COCO_POSE_MODEL_IN_FLASH_RODATA
        help
            coco_pose model location
        config COCO_POSE_MODEL_IN_FLASH_RODATA
            bool "flash_rodata"
        config COCO_POSE_MODEL_IN_FLASH_PARTITION
            bool "flash_partition"
        config COCO_POSE_MODEL_IN_SDCARD
            bool "sdcard"
    endchoice

    config COCO_POSE_MODEL_LOCATION
        int
        default 0 if COCO_POSE_MODEL_IN_FLASH_RODATA
        default 1 if COCO_POSE_MODEL_IN_FLASH_PARTITION
        default 2 if COCO_POSE_MODEL_IN_SDCARD

    config COCO_POSE_MODEL_SDCARD_DIR
        string "coco_pose model sdcard dir"
        default "models/s3" if IDF_TARGET_ESP32S3
        default "models/p4" if IDF_TARGET_ESP32P4
        depends on COCO_POSE_MODEL_IN_SDCARD
        help
            Directory of models relative to sdcard mount point.
endmenu
```
